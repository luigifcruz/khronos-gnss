## firmware/main/Kconfig.projbuild
```kconfig
menu "Khronos Configuration"

config SN
    string "Serial Number"
	default "Khronos SN0001"
	help 
		Khronos unique serial number.

config MDNS_HOSTNAME
    string "MDNS Hostname"
	default "khronos"
	help
		The mDNS hostname [this value].local
	
config MDNS_INSTANCE
    string "MDNS Instance"
	default "Khronos S/N SN0001"
	help
		The mDNS instance name.

config WIFI_SSID
    string "WiFi SSID"
	default "myssid"
	help
		Your Wi-Fi network name.

config WIFI_PASSWORD
    string "WiFi Password"
	default "mypassword"
	help
		Your Wi-Fi network password. Leave blank if insecure.

endmenu
```
